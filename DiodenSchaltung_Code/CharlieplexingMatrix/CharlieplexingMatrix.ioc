# file: CharlieplexingMatrix.ioc
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Mcu.Family=STM32G0
Mcu.Name=STM32G031J(4-6)Mx
Mcu.Package=SO8N
PA12\ [PA10].Signal=GPIO_Input
ProjectManager.HeapSize=0x200
ProjectManager.StackSize=0x400
ProjectManager.TargetToolchain=MDK-ARM V5.27
RCC.AHBFreq_Value=16000000
RCC.CortexFreq_Value=16000000
RCC.EXTERNAL_CLOCK_VALUE=12288000
RCC.HCLKFreq_Value=16000000
RCC.HSE_VALUE=8000000
RCC.HSI_VALUE=16000000
RCC.LSE_VALUE=32768
RCC.SYSCLKFreq_VALUE=16000000
RCC.VCOOutputFreq_Value=128000000
board=STM32G0316-DISCO

// file: Src/main.c
/* USER CODE BEGIN Header */
/**
  ******************************************************************************
  * @file           : main.c
  * @brief          : Main program body
  ******************************************************************************
  * @attention
  *
  * <h2><center>&copy; Copyright (c) 2020 STMicroelectronics.
  * All rights reserved.</center></h2>
  *
  * This software component is licensed by ST under BSD 3-Clause license,
  * the "License"; You may not use this file except in compliance with the
  * License. You may obtain a copy of the License at:
  *                        opensource.org/licenses/BSD-3-Clause
  *
  ******************************************************************************
  */
/* USER CODE END Header */

#include "main.h"

void SystemClock_Config(void);
static void MX_GPIO_Init(void);

int main(void)
{

  /* MCU Configuration--------------------------------------------------------*/

  /* Reset of all peripherals, Initializes the Flash interface and the Systick. */
  HAL_Init();

  /* Configure the system clock */
  SystemClock_Config();

  /* Initialize all configured peripherals */
  MX_GPIO_Init();

  /* Infinite loop */
  /* USER CODE BEGIN WHILE */
	int num = 0;

  while (1)
  {
		int val = HAL_GPIO_ReadPin (GPIOA,GPIO_PIN_12);
		if(val == GPIO_PIN_SET){
				num++;
				HAL_Delay(500);
				__HAL_RCC_GPIOA_CLK_ENABLE();
			  __HAL_RCC_GPIOB_CLK_ENABLE();
				switch(num) {
					case 0: break;
					case 1:

						GPIO_InitTypeDef GPIO_InitStruct1 = {0};

						HAL_GPIO_WritePin(GPIOA, GPIO_PIN_8, GPIO_PIN_RESET);

						GPIO_InitStruct1.Pin = GPIO_PIN_8;
						GPIO_InitStruct1.Mode = GPIO_MODE_OUTPUT_PP;
						GPIO_InitStruct1.Pull = GPIO_NOPULL;
						HAL_GPIO_Init(GPIOA, &GPIO_InitStruct1);

						GPIO_InitStruct1.Pin = GPIO_PIN_7;
						GPIO_InitStruct1.Mode = GPIO_MODE_INPUT;
						GPIO_InitStruct1.Pull = GPIO_NOPULL;
						HAL_GPIO_Init(GPIOB, &GPIO_InitStruct1);

						/* Insert delay 100 ms */
						HAL_Delay(100); break;
					case 2:

						GPIO_InitTypeDef GPIO_InitStruct2 = {0};

						HAL_GPIO_WritePin(GPIOB, GPIO_PIN_7, GPIO_PIN_RESET);

						GPIO_InitStruct2.Pin = GPIO_PIN_7;
						GPIO_InitStruct2.Mode = GPIO_MODE_OUTPUT_PP;
						GPIO_InitStruct2.Pull = GPIO_NOPULL;
						HAL_GPIO_Init(GPIOB, &GPIO_InitStruct2);

						GPIO_InitStruct2.Pin = GPIO_PIN_8;
						GPIO_InitStruct2.Mode = GPIO_MODE_INPUT;
						GPIO_InitStruct2.Pull = GPIO_NOPULL;
						HAL_GPIO_Init(GPIOA, &GPIO_InitStruct2);

						/* Insert delay 100 ms */
						HAL_Delay(100); break;
					case 3:

						GPIO_InitTypeDef GPIO_InitStruct3 = {0};

						HAL_GPIO_WritePin(GPIOA, GPIO_PIN_8, GPIO_PIN_SET);

						GPIO_InitStruct3.Pin = GPIO_PIN_8;
						GPIO_InitStruct3.Mode = GPIO_MODE_OUTPUT_PP;
						GPIO_InitStruct3.Pull = GPIO_NOPULL;
						HAL_GPIO_Init(GPIOA, &GPIO_InitStruct3);

						GPIO_InitStruct3.Pin = GPIO_PIN_7;
						GPIO_InitStruct3.Mode = GPIO_MODE_INPUT;
						GPIO_InitStruct3.Pull = GPIO_NOPULL;
						HAL_GPIO_Init(GPIOB, &GPIO_InitStruct3);

						num = 0;
						HAL_Delay(100); break;
					default: num = 0; break;
				}
			}
    /* USER CODE END WHILE */

  }
}

void SystemClock_Config(void)
{
  RCC_OscInitTypeDef RCC_OscInitStruct = {0};
  RCC_ClkInitTypeDef RCC_ClkInitStruct = {0};

  /** Configure the main internal regulator output voltage
  */
  HAL_PWREx_ControlVoltageScaling(PWR_REGULATOR_VOLTAGE_SCALE1);
  /** Initializes the CPU, AHB and APB busses clocks
  */
  RCC_OscInitStruct.OscillatorType = RCC_OSCILLATORTYPE_HSI;
  RCC_OscInitStruct.HSIState = RCC_HSI_ON;
  RCC_OscInitStruct.HSIDiv = RCC_HSI_DIV1;
  RCC_OscInitStruct.HSICalibrationValue = RCC_HSICALIBRATION_DEFAULT;
  RCC_OscInitStruct.PLL.PLLState = RCC_PLL_NONE;
  if (HAL_RCC_OscConfig(&RCC_OscInitStruct) != HAL_OK)
  {
    Error_Handler();
  }
  /** Initializes the CPU, AHB and APB busses clocks
  */
  RCC_ClkInitStruct.ClockType = RCC_CLOCKTYPE_HCLK|RCC_CLOCKTYPE_SYSCLK
                              |RCC_CLOCKTYPE_PCLK1;
  RCC_ClkInitStruct.SYSCLKSource = RCC_SYSCLKSOURCE_HSI;
  RCC_ClkInitStruct.AHBCLKDivider = RCC_SYSCLK_DIV1;
  RCC_ClkInitStruct.APB1CLKDivider = RCC_HCLK_DIV1;

  if (HAL_RCC_ClockConfig(&RCC_ClkInitStruct, FLASH_LATENCY_0) != HAL_OK)
  {
    Error_Handler();
  }
}

static void MX_GPIO_Init(void)
{
  GPIO_InitTypeDef GPIO_InitStruct = {0};

  /* GPIO Ports Clock Enable */
  __HAL_RCC_GPIOA_CLK_ENABLE();

  /*Configure GPIO pin : PA12 */
  GPIO_InitStruct.Pin = GPIO_PIN_12;
  GPIO_InitStruct.Mode = GPIO_MODE_INPUT;
  GPIO_InitStruct.Pull = GPIO_NOPULL;
  HAL_GPIO_Init(GPIOA, &GPIO_InitStruct);

}

void Error_Handler(void)
{
}

/************************ (C) COPYRIGHT STMicroelectronics *****END OF FILE****/
